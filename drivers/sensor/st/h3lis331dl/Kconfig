## drivers/sensor/st/h3lis331dl/Kconfig
```kconfig
# ST Microelectronics H3LIS331DL IMU sensor driver

# Copyright (c) 2025 Helbling TEchnik AG
# SPDX-License-Identifier: Apache-2.0

menuconfig H3LIS331DL
	bool "H3LIS331DL I2C/SPI accelerometer and gyroscope Chip"
	default y
	depends on DT_HAS_ST_H3LIS331DL_ENABLED
	depends on ZEPHYR_HAL_ST_MODULE
	select I2C if $(dt_compat_on_bus,$(DT_COMPAT_ST_H3LIS331DL),i2c)
	select SPI if $(dt_compat_on_bus,$(DT_COMPAT_ST_H3LIS331DL),spi)
	select HAS_STMEMSC
	select USE_STDC_H3LIS331DL
	help
	  Enable driver for H3LIS331DL accelerometer sensor.

if H3LIS331DL

endif # H3LIS331DL
```

## dts/bindings/sensor/st,h3lis331dl-i2c.yaml
```yaml
# Copyright (c) 2025 Helbling Technik AG
# SPDX-License-Identifier: Apache-2.0

description: |
    STMicroelectronics H3LSI331DL IMU sensor
    accessed through I2C bus

compatible: "st,h3lis331dl"

include: ["i2c-device.yaml", "st,h3lis331dl-common.yaml"]
```

## dts/bindings/sensor/st,h3lis331dl-spi.yaml
```yaml
# Copyright (c) 2025 Helbling Technik AG
# SPDX-License-Identifier: Apache-2.0

description: |
    STMicroelectronics H3LIS331DL IMU sensor
    accessed through SPI bus

compatible: "st,h3lis331dl"

include: ["spi-device.yaml", "st,h3lis331dl-common.yaml"]
```

## dts/bindings/sensor/st,lsm6dsr-spi.yaml
```yaml
# Copyright (c) 2018, Linaro Limited
# SPDX-License-Identifier: Apache-2.0

description: |
  STMicroelectronics LSM6DSR 6-axis accelerometer and gyrometer accessed through
  SPI bus

compatible: "st,lsm6dsr"

include: ["spi-device.yaml", "st,lsm6dsr-common.yaml"]
```
